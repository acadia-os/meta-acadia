## conf/layer.conf
```bitbake
# We have a conf and classes directory, add to BBPATH
BBPATH .= ":${LAYERDIR}"

# We have recipes-* directories, add to BBFILES
BBFILES += "${LAYERDIR}/recipes-*/*/*.bb \
            ${LAYERDIR}/recipes-*/*/*.bbappend"

BBFILE_COLLECTIONS += "meta-acadia"
BBFILE_PATTERN_meta-acadia = "^${LAYERDIR}/"
BBFILE_PRIORITY_meta-acadia = "6"

LAYERDEPENDS_meta-acadia = "core"
LAYERSERIES_COMPAT_meta-acadia = "nanbield"

LAYERDEPENDS_bsp-custom = "soccentric"
LAYERVERSION_bsp-custom = "1"
```
